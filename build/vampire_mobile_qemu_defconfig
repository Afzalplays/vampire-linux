## build/vampire_mobile_qemu_defconfig
```kconfig
BR2_aarch64=y
BR2_cortex_a53=y
BR2_TOOLCHAIN_BUILDROOT_MUSL=y
BR2_INIT_BUSYBOX=y
BR2_SYSTEM_DHCP=""
BR2_ROOTFS_OVERLAY=""
BR2_PACKAGE_BUSYBOX_SHOW_OTHERS=y
BR2_LINUX_KERNEL=y
BR2_LINUX_KERNEL_USE_DEFCONFIG=y
BR2_LINUX_KERNEL_DEFCONFIG="defconfig"
BR2_LINUX_KERNEL_NEEDS_HOST_OPENSSL=y
BR2_TARGET_ROOTFS_CPIO=y
BR2_TARGET_ROOTFS_CPIO_GZIP=y
BR2_TARGET_ROOTFS_TAR=y
BR2_TARGET_ROOTFS_EXT2=n
BR2_TARGET_ROOTFS_SQUASHFS=n
BR2_PACKAGE_BASH=y
BR2_PACKAGE_NFTABLES=y
BR2_PACKAGE_IPROUTE2=y
BR2_ROOTFS_DEVICE_CREATION_DYNAMIC_EUDEV=y
BR2_PACKAGE_EUDEV=y
BR2_PACKAGE_IW=y
BR2_PACKAGE_WPA_SUPPLICANT=y
BR2_PACKAGE_WPA_SUPPLICANT_NL80211=y
BR2_PACKAGE_WPA_SUPPLICANT_CTRL_IFACE=y
BR2_PACKAGE_WPA_SUPPLICANT_CLI=y
BR2_PACKAGE_PYTHON3=y
BR2_PACKAGE_PYTHON3_PY_ONLY=y
BR2_PACKAGE_PYTHON3_SSL=y
BR2_PACKAGE_PYTHON3_ZLIB=y
BR2_PACKAGE_MINISIGN=y
BR2_PACKAGE_DROPBEAR=y
BR2_PACKAGE_DROPBEAR_DISABLE_REVERSEDNS=y
BR2_PACKAGE_SDL2=y
BR2_PACKAGE_SDL2_TTF=y
BR2_PACKAGE_DEJAVU=y
BR2_PACKAGE_VAMPIRE_MOBILE_SHELL=y
```

## mobile/br2-external/Config.in
```kconfig
source "$BR2_EXTERNAL_VAMPIRE_MOBILE_PATH/package/vampire-mobile-shell/Config.in"
```

## mobile/br2-external/package/vampire-mobile-shell/Config.in
```kconfig
config BR2_PACKAGE_VAMPIRE_MOBILE_SHELL
	bool "Vampire Mobile touch shell"
	depends on BR2_PACKAGE_SDL2
	depends on BR2_PACKAGE_SDL2_TTF
	depends on BR2_PACKAGE_DEJAVU
	help
	  Native SDL2 touch-first home shell for the ARM64 mobile bring-up image.
	  It reports available devices and can return to the console.
```
